#ifndef OLED_h
#define OLED_h

#include "OLED.h"

#include <Wire.h> // Included in arduino core
#include <Adafruit_GFX.h> // https://github.com/adafruit/Adafruit-GFX-Library
#include <Adafruit_SSD1306.h> // https://github.com/adafruit/Adafruit_SSD1306

#define OLED_RESET -1
#define WIRE Wire

const unsigned char froge_bitmap_frogesmall [] PROGMEM = {
	0x00, 0x00, 0x00, 0x00, 0x00, 0x00, 0x00, 0x00, 0x00, 0x00, 0x00, 0x00, 0x00, 0x1f, 0xff, 0xff, 
	0x00, 0x00, 0x00, 0x00, 0x00, 0x00, 0x00, 0xff, 0xff, 0xff, 0xfe, 0x00, 0x00, 0x00, 0x00, 0x00, 
	0x1f, 0xff, 0xff, 0xff, 0xff, 0xe0, 0x00, 0x00, 0x00, 0x00, 0xff, 0xff, 0xff, 0xff, 0xff, 0xf0, 
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	0xfc, 0x00, 0x00, 0x00, 0x00, 0x00, 0x00, 0x00, 0x00, 0x00, 0x00, 0x00, 0x00, 0x00, 0x00, 0x00
};

void OLED::setup() {
  OLED::display = Adafruit_SSD1306(128, 32, &WIRE);
  // SSD1306_SWITCHCAPVCC = generate display voltage from 3.3V internally
  display.begin(SSD1306_SWITCHCAPVCC, 0x3C); // Address 0x3C for 128x32

  // Clear the buffer.
  display.clearDisplay();

  display.setTextSize(1);
  display.setTextColor(SSD1306_WHITE);
}

void OLED::clear()
{
  display.clearDisplay();
}

void OLED::cursor(int x, int y)
{
  display.setCursor(x, y);
}

void OLED::finish()
{
  display.display();
}

void OLED::drawFroge()
{
  clear();
  cursor();
  display.drawBitmap(0, 0, froge_bitmap_frogesmall, 74, 32, WHITE);
  finish();
}

void OLED::drawText(int line, String text)
{
  cursor(0, line);
  display.print(text);
}

void OLED::sensorScreen(float temp, int light, int moist, float pressure)
{
  clear();

  //TEMP
  drawText(0, "Temp:  " + String(temp) + "'C");

  //LIGHT
  float lightF = (float)light / 1024;
  int lightOn = (int)(lightF * 10);
  String lightPrint = "Light: ";
  for(int l = 0; l < 10; l++)
  {
    if(l < lightOn) { lightPrint += "#"; }
    else { lightPrint += "-"; }
  }
  drawText(8, lightPrint);

  //MOIST
  float moistF = (float)moist / 1024;
  int moistOn = (int)(moistF * 10);
  String moistPrint = "Soil:  ";
  for(int m = 0; m < 10; m++)
  {
    if(m < moistOn) { moistPrint += "#"; }
    else { moistPrint += "-"; }
  }
  drawText(16, moistPrint);

  //Pressure:
  drawText(24, "Press: " + String(pressure) + "Pa");

  finish();
}

void OLED::lastWaterScreen(int minutesAgo)
{
  clear();
  drawText(0, F("Last Water:"));
  drawText(8, String(minutesAgo) + "m ago");
  finish();
}

#endif